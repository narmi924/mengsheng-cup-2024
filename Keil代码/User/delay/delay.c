
//-----------------------------------------------------------------
// 头文件包含
//-----------------------------------------------------------------
#include "delay.h"
//-----------------------------------------------------------------
static u32 fac_us=0;	
	   
//-----------------------------------------------------------------
// void SysTick_clkconfig(u16 SYSCLK)
//-----------------------------------------------------------------
// 
// 函数功能: SysTick参数配置

//-----------------------------------------------------------------
void SysTick_clkconfig(u16 SYSCLK)
{
  HAL_SYSTICK_CLKSourceConfig(SYSTICK_CLKSOURCE_HCLK);// SysTick频率为HCLK
	fac_us=SYSCLK;
}								    

//-----------------------------------------------------------------
// void delay_us(u32 nus)
//-----------------------------------------------------------------
// 函数功能: SysTick延时us
//-----------------------------------------------------------------
void delay_us(u32 nus)
{		
	u32 ticks;
	u32 told,tnow,tcnt=0;
	u32 reload=SysTick->LOAD;			// LOAD的值	    	 
	ticks=nus*fac_us; 						// 需要的节拍数 
	told=SysTick->VAL;        		// 刚进入时的计数器值
	while(1)
	{
		tnow=SysTick->VAL;	
		if(tnow!=told)
		{	    
			if(tnow<told)				// 这里注意一下SYSTICK是一个递减的计数器就可以了.
				tcnt+=told-tnow;	
			else 
				tcnt+=reload-tnow+told;	    
			told=tnow;
			if(tcnt>=ticks)
				break;						// 时间超过/等于要延迟的时间,则退出.
		}  
	};
}

//-----------------------------------------------------------------
// void delay_ms(u16 nms)
//-----------------------------------------------------------------
// 函数功能: SysTick延时ms
//-----------------------------------------------------------------
void delay_ms(u16 nms)
{
	u32 i;
	for(i=0;i<nms;i++) 
		delay_us(1000);
}

//-----------------------------------------------------------------
// End Of File
//----------------------------------------------------------------- 	 
